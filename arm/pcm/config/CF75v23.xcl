-carm

//Тело патча
-Z(CODE)START,CODE,PATCH_BODY=A10F0000-A10F0600

//Список врезок
-Z(CODE)PATCH_VREZKA_01=A08FA114-FFFFFFFF //*
-Z(CODE)PATCH_VREZKA_02=A08F664C-FFFFFFFF //*
-Z(CODE)PATCH_VREZKA_03=A087C56C-FFFFFFFF //*
-Z(CODE)PATCH_VREZKA_04=A087CB40-FFFFFFFF //*
-Z(CODE)PATCH_VREZKA_05=A08F66C4-FFFFFFFF //*
-Z(CODE)PATCH_VREZKA_06=A07E7ED0-FFFFFFFF //*
-Z(CODE)PATCH_VREZKA_07=A08F9BC4-FFFFFFFF //*
-Z(CODE)PATCH_VREZKA_08=A08F9D38-FFFFFFFF //*
-Z(CODE)PATCH_VREZKA_09=A08FA16C-FFFFFFFF //*
-Z(CODE)PATCH_VREZKA_10=A08F9D20-FFFFFFFF //*
-Z(CODE)PATCH_VREZKA_11=A07E75F0-FFFFFFFF //*
-Z(CODE)PATCH_VREZKA_12=A07E7D88-FFFFFFFF //*
-Z(CODE)PATCH_VREZKA_13=A07E81BC-FFFFFFFF //*
-Z(CODE)PATCH_VREZKA_14=A07E7D40-FFFFFFFF //*

//Список локальных переходов
-Z(CODE)PATCH_JUMP_01=A07E7EFC-FFFFFFFF //PATCH_VREZKA_06 + 0x2C
-Z(CODE)PATCH_JUMP_02=A08FA1B0-FFFFFFFF //PATCH_VREZKA_09 + 0x44
-Z(CODE)PATCH_JUMP_03=A07E7618-FFFFFFFF //PATCH_VREZKA_11 + 0x28
-Z(CODE)PATCH_JUMP_04=A07E7DC0-FFFFFFFF //PATCH_VREZKA_14 + 0x80