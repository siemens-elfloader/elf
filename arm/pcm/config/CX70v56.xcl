-carm

//Тело патча
-Z(CODE)START,CODE,PATCH_BODY=A0D26920-A0D26F00

//Список врезок
-Z(CODE)PATCH_VREZKA_01=A11BB3A0-FFFFFFFF //*
-Z(CODE)PATCH_VREZKA_02=A11B78D8-FFFFFFFF //*
-Z(CODE)PATCH_VREZKA_03=A11950F4-FFFFFFFF //*
-Z(CODE)PATCH_VREZKA_04=A11956C8-FFFFFFFF //*
-Z(CODE)PATCH_VREZKA_05=A11B7950-FFFFFFFF //*
-Z(CODE)PATCH_VREZKA_06=A1165850-FFFFFFFF //*
-Z(CODE)PATCH_VREZKA_07=A11BAE50-FFFFFFFF //*
-Z(CODE)PATCH_VREZKA_08=A11BAFC4-FFFFFFFF //*
-Z(CODE)PATCH_VREZKA_09=A11BB3F8-FFFFFFFF //*
-Z(CODE)PATCH_VREZKA_10=A11BAFAC-FFFFFFFF //*
-Z(CODE)PATCH_VREZKA_11=A1164F70-FFFFFFFF //*
-Z(CODE)PATCH_VREZKA_12=A1165708-FFFFFFFF //*
-Z(CODE)PATCH_VREZKA_13=A1165B3C-FFFFFFFF //*
-Z(CODE)PATCH_VREZKA_14=A11656C0-FFFFFFFF //*

//Список локальных переходов
-Z(CODE)PATCH_JUMP_01=A116587C-FFFFFFFF //PATCH_VREZKA_06 + 0x2C
-Z(CODE)PATCH_JUMP_02=A11BB43C-FFFFFFFF //PATCH_VREZKA_09 + 0x44
-Z(CODE)PATCH_JUMP_03=A1164F98-FFFFFFFF //PATCH_VREZKA_11 + 0x28
-Z(CODE)PATCH_JUMP_04=A1165740-FFFFFFFF //PATCH_VREZKA_14 + 0x80