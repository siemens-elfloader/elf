-carm

//Тело патча
-Z(CODE)START,CODE,PATCH_BODY=A0D26920-A0D26F00

//Список врезок
-Z(CODE)PATCH_VREZKA_01=A11AAC5C-FFFFFFFF
-Z(CODE)PATCH_VREZKA_02=A11A7194-FFFFFFFF
-Z(CODE)PATCH_VREZKA_03=A118CDB4-FFFFFFFF
-Z(CODE)PATCH_VREZKA_04=A118D388-FFFFFFFF
-Z(CODE)PATCH_VREZKA_05=A11A720C-FFFFFFFF
-Z(CODE)PATCH_VREZKA_06=A1259ACC-FFFFFFFF
-Z(CODE)PATCH_VREZKA_07=A11AA70C-FFFFFFFF
-Z(CODE)PATCH_VREZKA_08=A11AA880-FFFFFFFF
-Z(CODE)PATCH_VREZKA_09=A11AACB4-FFFFFFFF
-Z(CODE)PATCH_VREZKA_10=A11AA868-FFFFFFFF
-Z(CODE)PATCH_VREZKA_11=A12591EC-FFFFFFFF

-Z(CODE)PATCH_VREZKA_12=A1259984-FFFFFFFF
-Z(CODE)PATCH_VREZKA_13=A1259DB8-FFFFFFFF
-Z(CODE)PATCH_VREZKA_14=A125993C-FFFFFFFF

//Список локальных переходов
-Z(CODE)PATCH_JUMP_01=A1259AF8-FFFFFFFF //PATCH_VREZKA_06 + 0x2C
-Z(CODE)PATCH_JUMP_02=A11AACF8-FFFFFFFF //PATCH_VREZKA_09 + 0x44
-Z(CODE)PATCH_JUMP_03=A1259214-FFFFFFFF //PATCH_VREZKA_11 + 0x28
-Z(CODE)PATCH_JUMP_04=A12599BC-FFFFFFFF //PATCH_VREZKA_14 + 0x80