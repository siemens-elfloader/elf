-carm

//Тело патча
-Z(CODE)START,CODE,PATCH_BODY=A13C8820-A13C8E00

//Список врезок
-Z(CODE)PATCH_VREZKA_01=A124E70C-FFFFFFFF
-Z(CODE)PATCH_VREZKA_02=A11B9750-FFFFFFFF 
-Z(CODE)PATCH_VREZKA_03=A11E16A0-FFFFFFFF
-Z(CODE)PATCH_VREZKA_04=A10F8240-FFFFFFFF
-Z(CODE)PATCH_VREZKA_05=A0CC8AAC-FFFFFFFF
-Z(CODE)PATCH_VREZKA_06=A059C5F8-FFFFFFFF
-Z(CODE)PATCH_VREZKA_07=A07C0474-FFFFFFFF
-Z(CODE)PATCH_VREZKA_08=A096ED14-FFFFFFFF //*
-Z(CODE)PATCH_VREZKA_09=A0CC8AA4-FFFFFFFF
-Z(CODE)PATCH_VREZKA_10=A096ECFC-FFFFFFFF //*
-Z(CODE)PATCH_VREZKA_11=A112E480-FFFFFFFF
-Z(CODE)PATCH_VREZKA_12=A0A8FCF8-FFFFFFFF //*
-Z(CODE)PATCH_VREZKA_13=A0158898-FFFFFFFF
-Z(CODE)PATCH_VREZKA_14=A0A326C2-FFFFFFFF

//Список локальных переходов
-Z(CODE)PATCH_JUMP_01=A059C624-FFFFFFFF //PATCH_VREZKA_06 + 0x2C
-Z(CODE)PATCH_JUMP_02=A0CC8AE8-FFFFFFFF //PATCH_VREZKA_09 + 0x44
-Z(CODE)PATCH_JUMP_03=A112E4A8-FFFFFFFF //PATCH_VREZKA_11 + 0x28
-Z(CODE)PATCH_JUMP_04=A0A326CA-FFFFFFFF //PATCH_VREZKA_14 + 0x80