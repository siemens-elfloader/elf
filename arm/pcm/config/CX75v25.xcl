-carm

//Тело патча
-Z(CODE)START,CODE,PATCH_BODY=A0FAB9C0-A0FABFA0

//Список врезок
-Z(CODE)PATCH_VREZKA_01=A096F0F4-FFFFFFFF //*
-Z(CODE)PATCH_VREZKA_02=A096A1C8-FFFFFFFF //*
-Z(CODE)PATCH_VREZKA_03=A08D88CC-FFFFFFFF //* -
-Z(CODE)PATCH_VREZKA_04=A08D8EA8-FFFFFFFF //*
-Z(CODE)PATCH_VREZKA_05=A096A240-FFFFFFFF //*
-Z(CODE)PATCH_VREZKA_06=A0A8FE40-FFFFFFFF //*
-Z(CODE)PATCH_VREZKA_07=A096EBA0-FFFFFFFF //*
-Z(CODE)PATCH_VREZKA_08=A096ED14-FFFFFFFF //*
-Z(CODE)PATCH_VREZKA_09=A096F14C-FFFFFFFF //* -
-Z(CODE)PATCH_VREZKA_10=A096ECFC-FFFFFFFF //*
-Z(CODE)PATCH_VREZKA_11=A0A8F560-FFFFFFFF //*
-Z(CODE)PATCH_VREZKA_12=A0A8FCF8-FFFFFFFF //*
-Z(CODE)PATCH_VREZKA_13=A0A9012C-FFFFFFFF //*
-Z(CODE)PATCH_VREZKA_14=A0A8FCB0-FFFFFFFF //*

//Список локальных переходов
-Z(CODE)PATCH_JUMP_01=A0A8FE6C-FFFFFFFF //PATCH_VREZKA_06 + 0x2C
-Z(CODE)PATCH_JUMP_02=A096F190-FFFFFFFF //PATCH_VREZKA_09 + 0x44
-Z(CODE)PATCH_JUMP_03=A0A8F588-FFFFFFFF //PATCH_VREZKA_11 + 0x28
-Z(CODE)PATCH_JUMP_04=A0A8FD30-FFFFFFFF //PATCH_VREZKA_14 + 0x80