-carm

//Тело патча
-Z(CODE)START,CODE,PATCH_BODY=A10F0000-A10F0600

//Список врезок
-Z(CODE)PATCH_VREZKA_01=A08F3864-FFFFFFFF //*
-Z(CODE)PATCH_VREZKA_02=A08EFD9C-FFFFFFFF //*
-Z(CODE)PATCH_VREZKA_03=A0873394-FFFFFFFF //*
-Z(CODE)PATCH_VREZKA_04=A0873968-FFFFFFFF //*
-Z(CODE)PATCH_VREZKA_05=A08EFE14-FFFFFFFF //*
-Z(CODE)PATCH_VREZKA_06=A07E0820-FFFFFFFF //*
-Z(CODE)PATCH_VREZKA_07=A08F3314-FFFFFFFF //*
-Z(CODE)PATCH_VREZKA_08=A08F3488-FFFFFFFF //*
-Z(CODE)PATCH_VREZKA_09=A08F38BC-FFFFFFFF //*
-Z(CODE)PATCH_VREZKA_10=A08F3470-FFFFFFFF //*
-Z(CODE)PATCH_VREZKA_11=A07DFF40-FFFFFFFF //*
-Z(CODE)PATCH_VREZKA_12=A07E06D8-FFFFFFFF //*
-Z(CODE)PATCH_VREZKA_13=A07E0B0C-FFFFFFFF //*
-Z(CODE)PATCH_VREZKA_14=A07E0690-FFFFFFFF //*

//Список локальных переходов
-Z(CODE)PATCH_JUMP_01=A07E084C-FFFFFFFF //PATCH_VREZKA_06 + 0x2C
-Z(CODE)PATCH_JUMP_02=A08F3900-FFFFFFFF //PATCH_VREZKA_09 + 0x44
-Z(CODE)PATCH_JUMP_03=A07DFF68-FFFFFFFF //PATCH_VREZKA_11 + 0x28
-Z(CODE)PATCH_JUMP_04=A07E0710-FFFFFFFF //PATCH_VREZKA_14 + 0x80