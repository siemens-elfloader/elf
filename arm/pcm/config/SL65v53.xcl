-carm

//Тело патча
-Z(CODE)START,CODE,PATCH_BODY=A0D26920-A0D26F00

//Список врезок
-Z(CODE)PATCH_VREZKA_01=A119D87C-FFFFFFFF //*
-Z(CODE)PATCH_VREZKA_02=A1199DB4-FFFFFFFF //*
-Z(CODE)PATCH_VREZKA_03=A1181D4C-FFFFFFFF //*
-Z(CODE)PATCH_VREZKA_04=A1182320-FFFFFFFF //*
-Z(CODE)PATCH_VREZKA_05=A1199E2C-FFFFFFFF //*
-Z(CODE)PATCH_VREZKA_06=A123FC2C-FFFFFFFF //*
-Z(CODE)PATCH_VREZKA_07=A119D32C-FFFFFFFF //*
-Z(CODE)PATCH_VREZKA_08=A119D4A0-FFFFFFFF //*
-Z(CODE)PATCH_VREZKA_09=A119D8D4-FFFFFFFF //*
-Z(CODE)PATCH_VREZKA_10=A119D488-FFFFFFFF //*
-Z(CODE)PATCH_VREZKA_11=A123F34C-FFFFFFFF //*
-Z(CODE)PATCH_VREZKA_12=A123FAE4-FFFFFFFF //*
-Z(CODE)PATCH_VREZKA_13=A123FF18-FFFFFFFF //*
-Z(CODE)PATCH_VREZKA_14=A123FA9C-FFFFFFFF //*

//Список локальных переходов
-Z(CODE)PATCH_JUMP_01=A123FC58-FFFFFFFF //PATCH_VREZKA_06 + 0x2C
-Z(CODE)PATCH_JUMP_02=A119D918-FFFFFFFF //PATCH_VREZKA_09 + 0x44
-Z(CODE)PATCH_JUMP_03=A123F374-FFFFFFFF //PATCH_VREZKA_11 + 0x28
-Z(CODE)PATCH_JUMP_04=A123FB1C-FFFFFFFF //PATCH_VREZKA_14 + 0x80