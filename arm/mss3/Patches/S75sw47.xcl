-carm
//MySMSYS replace the OpenWave sms system

-Z(CODE)CODE,DATA_C,MY_SMS_SYS_PBODY=A1562600-FFFFFFFF

-Z(CODE)AB_UPDATE_HOOK=A0649CC8-FFFFFFFF //this
-Z(CODE)COUNT_IN_HOOK=A06076E0-FFFFFFFF
-Z(CODE)OTHER_COUNT_HOOK=A0607064-FFFFFFFF

-Z(CODE)NEW_IN_WIN_HOOK=A02FDB78-FFFFFFFF

-Z(CODE)INBOX_VIEW_HOOK=A04C9F58-FFFFFFFF
-Z(CODE)INBOX_OPVIEW_HOOK=A04CA3CC-FFFFFFFF
-Z(CODE)INBOX_OTH_HOOK=A04DD0EC-FFFFFFFF
-Z(CODE)INBOX_REC_HOOK=A04DBDA4-FFFFFFFF

-Z(CODE)NMENU_INBOX_HOOK=A0606C24-FFFFFFFF
-Z(CODE)NMENU_DRAFT_HOOK=A0606C30-FFFFFFFF
-Z(CODE)NMENU_SENT_HOOK=A0606C48-FFFFFFFF //this
-Z(CODE)NMENU_NEWSMG_HOOK=A0606C00-FFFFFFFF
-Z(CODE)NMENU_ARCHIVE_HOOK=A0606C54-FFFFFFFF

-Z(CODE)ADRBK_NUM_SMS_HOOK=A05F82D4-FFFFFFFF //this

-Z(CODE)SHORTCUT_NEWMSG_HOOK=A032D8F0-FFFFFFFF
-Z(CODE)SHORTCUT_DRAFT_HOOK=A032D96C-FFFFFFFF
-Z(CODE)SMS_SENT_HOOK=A032DAD4-FFFFFFFF
-Z(CODE)SMS_INBOX_HOOK=A032D914-FFFFFFFF
-Z(CODE)SHORTCUT_SAVED_HOOK=A0330FAC-FFFFFFFF

-Z(CODE)ORG_SEND_HOOK=A04E6EC4-FFFFFFFF

-Z(CODE)REC_SENDSMS_HOOK=A058B944-FFFFFFFF

-Z(CODE)DIAL_SMS_HOOK=A02F5754-FFFFFFFF
-Z(CODE)MMENU_INBOX_CNT_HOOK=A032D92C-FFFFFFFF
-Z(CODE)MMENU_DRAFT_CNT_HOOK=A032D994-FFFFFFFF
-Z(CODE)MMENU_SENT_CNT_HOOK=A032DAFC-FFFFFFFF