-carm
//MySMSYS replace the OpenWave sms system

-Z(CODE)CODE,DATA_C,MY_SMS_SYS_PBODY=A1562600-FFFFFFFF //yes

-Z(CODE)AB_UPDATE_HOOK=A068BB44-FFFFFFFF //not
-Z(CODE)COUNT_IN_HOOK=A0607FE0-FFFFFFFF //yes
-Z(CODE)OTHER_COUNT_HOOK=A0607964-FFFFFFFF //yes

-Z(CODE)NEW_IN_WIN_HOOK=A02FDF00-FFFFFFFF //yes

-Z(CODE)INBOX_VIEW_HOOK=A04CA564-FFFFFFFF //yes or A04CA57C
-Z(CODE)INBOX_OPVIEW_HOOK=A04CA9D8-FFFFFFFF //yes
-Z(CODE)INBOX_OTH_HOOK=A04DD71C-FFFFFFFF //yes
-Z(CODE)INBOX_REC_HOOK=A04DC3D4-FFFFFFFF //yes

-Z(CODE)NMENU_INBOX_HOOK=A0607524-FFFFFFFF //yes
-Z(CODE)NMENU_DRAFT_HOOK=A0607530-FFFFFFFF //yes
-Z(CODE)NMENU_SENT_HOOK=A0607548-FFFFFFFF //yes or 606C6E
-Z(CODE)NMENU_NEWSMG_HOOK=A0607500-FFFFFFFF //yes
-Z(CODE)NMENU_ARCHIVE_HOOK=A0607554-FFFFFFFF //yes

-Z(CODE)ADRBK_NUM_SMS_HOOK=A063A150-FFFFFFFF //not

-Z(CODE)SHORTCUT_NEWMSG_HOOK=A032DD1C-FFFFFFFF //yes
-Z(CODE)SHORTCUT_DRAFT_HOOK=A032DD98-FFFFFFFF //yes
-Z(CODE)SMS_SENT_HOOK=A0345CF0-FFFFFFFF //not
-Z(CODE)SMS_INBOX_HOOK=A032DD40-FFFFFFFF //yes or A032EB0E
-Z(CODE)SHORTCUT_SAVED_HOOK=A0330EBC-FFFFFFFF //yes

-Z(CODE)ORG_SEND_HOOK=A04E74F4-FFFFFFFF //yes

-Z(CODE)REC_SENDSMS_HOOK=A058C080-FFFFFFFF //yes

-Z(CODE)DIAL_SMS_HOOK=A02F5A60-FFFFFFFF //yes
-Z(CODE)MMENU_INBOX_CNT_HOOK=A032DD58-FFFFFFFF //yes
-Z(CODE)MMENU_DRAFT_CNT_HOOK=A032DDC0-FFFFFFFF //yes
-Z(CODE)MMENU_SENT_CNT_HOOK=A032DF28-FFFFFFFF //yes