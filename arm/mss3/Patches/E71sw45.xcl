-carm
//MySMSYS replace the OpenWave sms system
//(p)snoopyhzy

-Z(CODE)CODE,DATA_C,MY_SMS_SYS_PBODY=A1562600-FFFFFFFF

-Z(CODE)AB_UPDATE_HOOK=A07E6218-FFFFFFFF //3D300059012803D1

-Z(CODE)COUNT_IN_HOOK=A07AE374-FFFFFFFF //1AA915A8269F0622
-Z(CODE)OTHER_COUNT_HOOK=A07ADCF8-FFFFFFFF //1D1C062206A901A8

-Z(CODE)NEW_IN_WIN_HOOK=A066C040-FFFFFFFF //F607051C0027201C

-Z(CODE)INBOX_VIEW_HOOK=A050582C-FFFFFFFF //5E9BF0683169FFF7??FA 
-Z(CODE)INBOX_OPVIEW_HOOK=A0505D04-FFFFFFFF //5C9A5D9B0169C068
-Z(CODE)INBOX_OTH_HOOK=A05D9DC8-FFFFFFFF //40680068125D011C
-Z(CODE)INBOX_REC_HOOK=A05D8550-FFFFFFFF //00 7A 16 28 4F D1 1A A0

-Z(CODE)NMENU_INBOX_HOOK=A07AD8B8-FFFFFFFF //80B5002141A0
-Z(CODE)NMENU_DRAFT_HOOK=A07AD8C4-FFFFFFFF //80B5002142A0
-Z(CODE)NMENU_SENT_HOOK=A07AD8DC-FFFFFFFF //80B5002144A0
-Z(CODE)NMENU_NEWSMG_HOOK=A07AD894-FFFFFFFF //80B500213AA0

-Z(CODE)ADRBK_NUM_SMS_HOOK=A0762868-FFFFFFFF //6B44099018690028

-Z(CODE)SHORTCUT_NEWMSG_HOOK=A06E7CF4-FFFFFFFF //80B500215AA0
-Z(CODE)SHORTCUT_DRAFT_HOOK=A06E7DA4-FFFFFFFF  //80B5002145A0
-Z(CODE)SMS_SENT_HOOK=A06E7F08-FFFFFFFF  //80B50021D7A0
-Z(CODE)SMS_INBOX_HOOK=A06E7D18-FFFFFFFF //80B5002161A0


-Z(CODE)ORG_SEND_HOOK=A05E6588-FFFFFFFF //18760DA0

-Z(CODE)REC_SENDSMS_HOOK=A09A2C28-FFFFFFFF //059700AB1F76B068

-Z(CODE)DIAL_SMS_HOOK=A0662B6C-FFFFFFFF //29A0211C