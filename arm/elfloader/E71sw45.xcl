-carm
-Z(CODE)START,CODE,SWITAB,INITTAB,DATA_ID,CONFIG_DATA_ID,DATA_C=A1324000-A1328000



 
-Z(DATA)CONFIG_DATA_I,DATA_N=A8D9F178-A8D9FAD7

-Z(CODE)PATCH_ONCREATE=A084B698-A084B69B
-Z(CODE)PATCH_ONCLOSE=A084B6AC-A084B6AF


-Z(CODE)PATCH_ESI1=A08D5FF4-A08D5FF7
-Z(CODE)PATCH_ESI2=A08D6004-A08D6007

-Z(CODE)PATCH_SHOWMSG_BLF=A07F9600-A07F9603
-Z(CODE)PATCH_NO_BROWSE_TXT=A06C697A-A06C697D



-Z(CODE)SWILIB_FUNC171=A13205C4-A13205C7
-Z(CODE)SWILIB_FUNC172=A13205C8-A13205CB
-Z(CODE)SWILIB_FUNC19C=A1320670-A1320673
-Z(CODE)SWILIB_FUNC1B8_1BB=A13206E0-A13206EF
-Z(CODE)SWILIB_FUNC1E9=A13207A4-A13207A7
-Z(CODE)SWILIB_FUNC2DF=A1320F54-A1320F57


-Z(DATA)REGEXPL_CNT=A8D9F174-A8D9F177

-Z(CODE)PATCH_EXT2_R7=A0502A78-A0502A7B
-Z(CODE)PATCH_EXT2_R6=A0502C5C-A0502C5F
-Z(CODE)PATCH_EXT2_R7_1=A05026AC-A05026AF
-Z(CODE)PATCH_EXT2_R2=A0502830-A0502833

-Z(CODE)PATCH_EXT2_IMPL=A0502AFC-A0502B1F

-Z(CODE)PATCH_ENABLE_ALTOPEN=A071CDD4-A071CDD7

-Z(CODE)PATCH_GET_PIT=A094CE9A-A094CE9D
-Z(CODE)PATCH_GET_PITJ=A094CEA0-A094CEA3

-Z(CODE)FSWI_PATCH1=A12D1414-A12D1417  //000002A4+A13A10D0
-Z(CODE)FSWI_PATCH2=A12D1328-A12D132B  //000001B8+A13A10D0
-Z(CODE)LIBR=A1320000-A1323FFF
