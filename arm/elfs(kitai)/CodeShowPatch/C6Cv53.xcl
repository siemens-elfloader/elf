-carm
-Z(CODE)JMP_BODY=A0A71650-FFFFFFFF

-Z(CODE)CODE,DATA_C=A080F540-FFFFFFFF  
-Z(CODE)RecordWindow=A0BEB8CE-FFFFFFFF 
-Z(CODE)Callinwindow=A09924DC-FFFFFFFF 
-Z(CODE)CallOutWindow=A0991898-FFFFFFFF 
-Z(CODE)AddrBookWindow=A0BE6220-FFFFFFFF 
-Z(CODE)AddrBookWindow2=A0BE6212-FFFFFFFF 
-Z(CODE)PhonebookWindow=A0C563FC-FFFFFFFF 
-Z(CODE)SMS_SEND_HOOK=A16C3A20-FFFFFFFF 

-Z(CODE)SMS_IN_HOOK=0xA093229C-FFFFFFFF  //OK
-Z(CODE)CODE_X=A0810000-FFFFFFFF  //OK

-Z(CODE)SMS_SEND_FIX=0xA16C39D2-FFFFFFFF  //OK

-Z(CODE)NUM_SELECT_MENU_ALITEM=A0C7461C-FFFFFFFF //8298????????0090+2
-Z(CODE)NUM_SELECT_MENU_TEXT=A0C74680-FFFFFFFF //8298839B0099
-Z(CODE)NUM_SELECT_MENU_GUI=A0C7454E-FFFFFFFF  //381C6649+4
-Z(CODE)NUM_SELECT_MENU_HDR_ICON=A0CDC128-FFFFFFFF //6162656469747669657773F70000+16h
-Z(CODE)NUM_SELECT_MENU_LINES=A0CDC160-FFFFFFFF //NUM_SELECT_MENU_HDR_ICON+38h

-Z(CODE)SMSHeader_HOOK=A16D3290-FFFFFFFF  //2B1C221C04980399