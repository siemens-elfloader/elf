-carm
-Z(CODE)CODE,DATA_C,DATA_Z,DATA_I,DATA_ID,INITTAB=A01FFA00-FFFFFFFF
-Z(CODE)CODE_X=A01FE450-FFFFFFFF //ԭ�հ׵�ַ�ռ䲻��
-Z(CODE)RecordWindow=A0554B54-FFFFFFFF
-Z(CODE)Callinwindow=A038F48C-FFFFFFFF
-Z(CODE)CallOutWindow=A038E84A-FFFFFFFF
-Z(CODE)AddrBookWindow=A054DDBC-FFFFFFFF
-Z(CODE)AddrBookWindow2=A054DDAE-FFFFFFFF
-Z(CODE)PhonebookWindow=A057B1EC-FFFFFFFF
-Z(CODE)SMS_SEND_HOOK=A04F1BC4-FFFFFFFF

-Z(CODE)SMS_IN_HOOK=0xA031E508-FFFFFFFF  //OK

-Z(CODE)SMS_SEND_FIX=0xA04F1B76-FFFFFFFF  //OK

-Z(CODE)NUM_SELECT_MENU_ALITEM=A058C570-FFFFFFFF //8298????????0090+2
-Z(CODE)NUM_SELECT_MENU_TEXT=A058C5D4-FFFFFFFF //8298839B0099
-Z(CODE)NUM_SELECT_MENU_GUI=A058C4A2-FFFFFFFF  //381C6649+4
-Z(CODE)NUM_SELECT_MENU_HDR_ICON=A0711F50-FFFFFFFF //6162656469747669657773F70000+16h
-Z(CODE)NUM_SELECT_MENU_LINES=A0711F88-FFFFFFFF //NUM_SELECT_MENU_HDR_ICON+38h

-Z(CODE)SMSHeader_HOOK=A05403D0-FFFFFFFF  //2B1C221C04980399