-carm
-Z(CODE)CODE,DATA_C=A080F540-FFFFFFFF  //OK
-Z(CODE)RecordWindow=A0B9A188-FFFFFFFF //
-Z(CODE)Callinwindow=A0974F20-FFFFFFFF //OK
-Z(CODE)CallOutWindow=A09742EE-FFFFFFFF //OK
-Z(CODE)AddrBookWindow=A0B94B00-FFFFFFFF //
-Z(CODE)AddrBookWindow2=A0B94AF2-FFFFFFFF //
-Z(CODE)PhonebookWindow=A0BE39CC-FFFFFFFF //OK
-Z(CODE)SMS_SEND_HOOK=A160FC6C-FFFFFFFF  //OK
-Z(CODE)SMS_IN_HOOK=0xA092803C-FFFFFFFF  //OK
-Z(CODE)CODE_X=A0810000-FFFFFFFF  //OK
-Z(CODE)SMS_SEND_FIX=0xA160FC1E-FFFFFFFF  //OK

-Z(CODE)NUM_SELECT_MENU_ALITEM=A0C05FB8-FFFFFFFF //8298????????0090+2
-Z(CODE)NUM_SELECT_MENU_TEXT=A0C0601C-FFFFFFFF //8298839B0099
-Z(CODE)NUM_SELECT_MENU_GUI=A0C05EEA-FFFFFFFF  //381C6649+4
-Z(CODE)NUM_SELECT_MENU_HDR_ICON=A0C5E0E4-FFFFFFFF //6162656469747669657773F70000+16h
-Z(CODE)NUM_SELECT_MENU_LINES=A0C5E11C-FFFFFFFF //NUM_SELECT_MENU_HDR_ICON+38h

-Z(CODE)SMSHeader_HOOK=A1627010-FFFFFFFF  //2B1C221C04980399
