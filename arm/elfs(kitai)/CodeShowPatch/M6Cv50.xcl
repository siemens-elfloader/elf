-carm
-Z(CODE)CODE,DATA_C=A080F540-FFFFFFFF
-Z(CODE)RecordWindow=A0B9A4FC-FFFFFFFF
-Z(CODE)Callinwindow=A0974F20-FFFFFFFF
-Z(CODE)CallOutWindow=A09742EE-FFFFFFFF
-Z(CODE)AddrBookWindow=A0B94E78-FFFFFFFF
-Z(CODE)AddrBookWindow2=A0B94E6A-FFFFFFFF
-Z(CODE)PhonebookWindow=A0BE3D40-FFFFFFFF
-Z(CODE)SMS_SEND_HOOK=A160F890-FFFFFFFF

-Z(CODE)SMS_IN_HOOK=0xA092803C-FFFFFFFF  //OK
-Z(CODE)CODE_X=A0810000-FFFFFFFF  //OK

-Z(CODE)SMS_SEND_FIX=0xA160F842-FFFFFFFF  //OK

-Z(CODE)NUM_SELECT_MENU_ALITEM=A0C0632C-FFFFFFFF //8298????????0090+2
-Z(CODE)NUM_SELECT_MENU_TEXT=A0C06390-FFFFFFFF //8298839B0099
-Z(CODE)NUM_SELECT_MENU_GUI=A0C0625E-FFFFFFFF  //381C6649+4
-Z(CODE)NUM_SELECT_MENU_HDR_ICON=A0C5E4B4-FFFFFFFF //6162656469747669657773F70000+16h
-Z(CODE)NUM_SELECT_MENU_LINES=A0C5E4EC-FFFFFFFF //NUM_SELECT_MENU_HDR_ICON+38h

-Z(CODE)SMSHeader_HOOK=A1626C34-FFFFFFFF  //2B1C221C04980399
