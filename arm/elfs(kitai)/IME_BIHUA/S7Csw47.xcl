-carm
-Z(CODE)CODE=A1564F00-FFFFFFFF
-Z(CODE)IME_HOOK=A0ACFEB8-FFFFFFFF

//-Z(CODE)SELECT_HOOK=A0AD0538-FFFFFFFF //XX
-Z(CODE)JAVA_BD_POP_HOOK=A05B4420-FFFFFFFF
-Z(CODE)SYS_BD_POP_HOOK=A0A246E4-FFFFFFFF
-Z(CODE)DISABLE_REDICAL_HOOK=A0ACFDCE-FFFFFFFF

-Z(CODE)INPUTER_SEL_JAVA_HOOK=A00B500C-FFFFFFFF
-Z(CODE)KEY0_JAVA_HOOK=A05B436C-FFFFFFFF
-Z(CODE)OTH_FIX_BODY=A1565080-FFFFFFFF
