-carm
-Z(CODE)CODE=A1515700-FFFFFFFF  //�ҿհ׵�ַ
-Z(CODE)IME_HOOK=A0AD8034-FFFFFFFF
-Z(CODE)SELECT_HOOK=A0AD86B4-FFFFFFFF
-Z(CODE)JAVA_BD_POP_HOOK=A05CBC94-FFFFFFFF
-Z(CODE)SYS_BD_POP_HOOK=A0A26608-FFFFFFFF

-Z(CODE)INPUTER_SEL_JAVA_HOOK=A00B500C-FFFFFFFF
-Z(CODE)KEY0_JAVA_HOOK=A05CBBE0-FFFFFFFF
-Z(CODE)OTH_FIX_BODY=A1515880-FFFFFFFF  //�ҿհ׵�ַ