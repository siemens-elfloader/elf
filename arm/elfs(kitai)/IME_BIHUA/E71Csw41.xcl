-carm
-Z(CODE)CODE=A135C800-FFFFFFFF
-Z(CODE)IME_HOOK=A0B20FF0-FFFFFFFF
-Z(CODE)SELECT_HOOK=A0B21670-FFFFFFFF
-Z(CODE)JAVA_BD_POP_HOOK=A06EF288-FFFFFFFF
-Z(CODE)SYS_BD_POP_HOOK=A0A3D628-FFFFFFFF

-Z(CODE)INPUTER_SEL_JAVA_HOOK=A00B6738-FFFFFFFF
-Z(CODE)KEY0_JAVA_HOOK=A06EF1D4-FFFFFFFF
-Z(CODE)OTH_FIX_BODY=A135C980-FFFFFFFF