-carm
-Z(CODE)CODE,DATA_C=A1359680-FFFFFFFF
-Z(CODE)RUN_ELF_CODE,RUN_ELF_DATA_C=A1359830-FFFFFFFF
-Z(CODE)SMSHook=A0E4F650-FFFFFFFF
-Z(CODE)SMS_COUNT_JMP=A0D11210-FFFFFFFF
-Z(CODE)SMS_FIX_HOOK=A0D51868-FFFFFFFF
-Z(CODE)HookShow=A0860BB4-FFFFFFFF
