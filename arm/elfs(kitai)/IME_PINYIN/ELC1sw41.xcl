-carm
//拼音输入法修改
-Z(CODE)IME_HOOK=A0B269F0-FFFFFFFF
-Z(CODE)IME_KEY1_HOOK=A0B26FFC-FFFFFFFF
-Z(CODE)INPUTER_SEL_JAVA_HOOK=A00B6738-FFFFFFFF //竟然和E71一样，^_^不用移咯
-Z(CODE)CODE=A135C600-FFFFFFFF

-Z(CODE)XING_JAVA_HOOK=A06F6444-FFFFFFFF
-Z(CODE)KEY0_JAVA_HOOK=A06F6B00-FFFFFFFF
