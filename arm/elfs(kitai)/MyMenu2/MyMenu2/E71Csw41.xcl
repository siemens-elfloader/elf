-carm
-Z(CODE)ENTRYPOINT_ONLINE_STATUS=A0863034-FFFFFFFF
-Z(CODE)ENTRYPOINT_ONLINE_STATUS1=A0863AB4-FFFFFFFF
-Z(CODE)ENTRYPOINT_SAT=A08640B4-FFFFFFFF
-Z(CODE)SAT_PROC=A086411C-FFFFFFFF
-Z(CODE)SAT_LGP=A08640E4-FFFFFFFF
-Z(CODE)SAT_LGP1=A08640F4-FFFFFFFF
-Z(CODE)SAT_LGP2=A0864104-FFFFFFFF
-Z(CODE)CODE,DATA_C,DATA_ID,INITTAB=A1359F00-FFFFFFFF
-Z(DATA)DATA_Z,DATA_I=A8D80580-FFFFFFFF
