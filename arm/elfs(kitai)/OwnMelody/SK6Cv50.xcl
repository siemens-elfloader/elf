-carm
-Z(CODE)TYPE_SAVE,START,CODE,SWITAB,INITTAB,DATA_ID,DATA_C,CONFIG_DATA_ID=A01F3000-A08033FF

-Z(CODE)PATCH_ENTRY=A033FC5C-FFFFFFFF //00 50 A0 E1 1C 00 00 EA-4
-Z(CODE)TYPE_ENTRY=A02DF9EC-FFFFFFFF //73 6F 75 6E 64 5F 61 65 2F 73 61 65 5F 65 5F 61 70 69 2E 63 00 00 00 00-34
//-Z(CODE)TYPE_SAVE=A0803000-A080300F 

-Z(CODE)ADDR_DB_FNAME=A8E60044 //10 80 00 00 ???????? ???????? 00 20 E8 E7
