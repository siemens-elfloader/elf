#include "..\inc\swilib.h"
#include "..\inc\cfg_items.h"
#include "conf_loader.h"

// Импорт переменных
extern const char cfgINTNAME[40];
extern const char cfgNAME[20];
extern const char cfgAPN[30];
extern const int ENA_GPRSD;
extern const char cfgUSER[20];
extern const char cfgPASS[20];
extern const unsigned int cfgTimeout;
extern const char cfgDNS[20];

// Пустышка, все поля забиты нулями
// Используем для инициализации
const char profile_template[0x204] = {
	0x00, 0x00, 0x00, 0x00, 0x00, 0x00, 0x00, 0x00, 0x00, 0x00, 0x00, 0x00, 0x00, 0x00, 0x00, 0x00, 
	0x00, 0x00, 0x00, 0x00, 0x00, 0x00, 0x00, 0x00, 0x00, 0x00, 0x00, 0x00, 0x00, 0x00, 0x00, 0x00, 
	0x00, 0x00, 0x00, 0x00, 0x00, 0x00, 0x00, 0x00, 0x00, 0x00, 0x00, 0x00, 0x00, 0x00, 0x00, 0x00, 
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	0x05, 0x00, 0x00, 0x00, 0x00, 0x00, 0x00, 0x00, 0x00, 0x00, 0x00, 0x00, 0x00, 0x00, 0x00, 0x00, 
//            ^^^^^^^^^^^^^^^^^^^^^^ DNS                ^^^^ флаг, что DNS !=0

	0x00, 0x00, 0x00, 0x00, 0x01, 0x00, 0x00, 0x00, 0x00, 0x00, 0x00, 0x00, 0x00, 0x00, 0x00, 0x00, 
	0x00, 0x00, 0x00, 0x00, 0x00, 0x00, 0x00, 0x00, 0x00, 0x00, 0x00, 0x00, 0x00, 0x00, 0x00, 0x00, 
	0x00, 0x00, 0x00, 0x00, 0x00, 0x00, 0x00, 0x00, 0x00, 0x00, 0x00, 0x00, 0x00, 0x00, 0x00, 0x00, 
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	0x00, 0x00, 0x00, 0x00
};

// Заполняет поля профиля
// Вход - указатель на буфер
// Выход - буфер заполнен нужными данными
void FillProfile(char *profile)
{
  memcpy(profile, profile_template, 0x204); // Template => наст.профайл

  // Определяем указатели на поля профиля
  char *apn_place = profile + coAPN_name;
  char *user_place = profile + coLogin;
  char *pass_place = profile + coPass;
  char *name_place= profile + coName;
  char *intname_place= profile + coIntName;
  unsigned int *timeout_place =(unsigned int*)(profile + coTimeout);
  
  // Заполняем информацию
  strcpy(intname_place, cfgINTNAME);
  strcpy(name_place, cfgNAME);
  strcpy(user_place, cfgUSER);
  strcpy(pass_place, cfgPASS);
  strcpy(apn_place, cfgAPN);
  memcpy(timeout_place, &cfgTimeout, 4);
  unsigned int dnsip;
  dnsip=str2ip(cfgDNS);
  if (dnsip != 0xFFFFFFFF)
  {
    memcpy(profile+coDNS,&dnsip,4);
    profile[coDNS_flag]=1;
  }
//  ShowMSG(1,(int)cfgAPN);
}


// Загрузить конфигурационный файл по пути fname (взято из XTask)
// Конфигурационный загрузчик (c) Rst7
#pragma segment="CONFIG_C"
int LoadConfigData(const char *fname)
{
  int f;
  unsigned int ul;
  char *buf;
  int result=0;
  void *cfg;

  extern const CFG_HDR cfghdr0; //first var in CONFIG
  cfg=(void*)&cfghdr0;

  unsigned int len=(int)__segment_end("CONFIG_C")-(int)__segment_begin("CONFIG_C");

  if (!(buf=malloc(len))) return -1;
  if ((f=fopen(fname,A_ReadOnly+A_BIN,0,&ul))!=-1)
  {
    if (fread(f,buf,len,&ul)==len)
    {
      memcpy(cfg,buf,len);
      fclose(f,&ul);
    }
    else
    {
      fclose(f,&ul);
      goto L_SAVENEWCFG;
    }
  }
  else
  {
  L_SAVENEWCFG:
    if ((f=fopen(fname,A_ReadWrite+A_Create+A_Truncate,P_READ+P_WRITE,&ul))!=-1)
    {
      if (fwrite(f,cfg,len,&ul)!=len) result=-1;
      fclose(f,&ul);
    }
    else
      result=-1;
  }
  mfree(buf);
  return(result);
}

/*
  Возвращает строку вида CC-NC - параметры текущей сети в буфере.
  возвращает 0, Если сети не обнаружено:)
*/
char get_net_id(char *buf)
{
  char *x = (char*)Get_CC_NC();
  char *y = x+1;
  char *z = x+2;
  char cc_2 = *x;
  char cc_1 = *y;
  // Немного жёсткого секса с BCD...
  if(cc_1>=0xF0){cc_1 = cc_1 && 0x0F>>4;}
  cc_2 = (cc_2<<4) + (cc_2>>4);
  char nc = *z;
  nc = (nc>>4) + (nc<<4);
  if((nc == 0xFF)&&(cc_2==0xFF))
  {
    return 0;
  }
  // ... и золотой ключик у нас в кармане )
  sprintf(buf, "%X%X-%02X", cc_2, cc_1, nc);
  return 1;
}


// Инициализация конфигурации
// Надо вызвать в начале работы для загрузки конфигурации
// Поиск конфиг-файла согласно стандарту
char config_name[128];

void InitConfig()
{
  char buf[10];
  if(!get_net_id((char*)&buf))
  {
    return;
  }
  sprintf(config_name,"4:\\ZBin\\etc\\GprsD_%s.bcfg", buf);
  //ShowMSG(1,(int)config_name);
  if(LoadConfigData(config_name)<0)
  {
    config_name[0] = '0';
    LoadConfigData(config_name);
  }
}
