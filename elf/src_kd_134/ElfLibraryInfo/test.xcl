-carm
//-Z(CODE)START,CODE,SWITAB=00000000-FFFFFFFF
//-Z(CODE)PATCH1=0x00004000-FFFFFFFF
//-Z(CONST)INITTAB,DATA_ID,DATA_C=00000000-FFFFFFFF
//-Z(DATA)DATA_I,CONFIG_I,CONFIG_Z,DATA_Z,DATA_N=00000000-FFFFFFFF


// Declare relocation areas for code, constants and data.
-V(CODE)CODE_AREA,12
//-V(CONST)CONFIG,12
-V(DATA)DATA_AREA,12
//-U(CODE_AREA)0-FFFFFFFF=(CONST_AREA)0-FFFFFFFF

// Place segments into the relocation areas
-Z(CODE_AREA)ELFBEGIN,DATA_ID,START,CODE,DATA_C,INITTAB,DATA_Z,DATA_N,CONFIG_C=0-FFFFFFFF
-Z(DATA_AREA)DATA_I=0-FFFFFFFF
// -Felf
