-carm
-Z(CODE)START,CODE,SWITAB=A0A0A02E-A0A0A21B
//-Z(CODE)PATCH=A089F9F0-A089F9F7
-Z(CODE)PATCH=A0A0A02C-A0A0A02D


-Z(CODE)PATCHLONGPRESS=A0A0A5E8-A0A0A5E8
-Z(CODE)PATCHSHIFT=A0A0A786-A0A0A789

//-Z(DATA)DATA_I,DATA_Z,DATA_N=00000000-FFFFFFFF

// Declare relocation areas for code, constants and data.
//-V(CODE)CODE_AREA,12
//-V(DATA)DATA_AREA,12
//-U(CODE_AREA)0-FFFFFFFF=(CONST_AREA)0-FFFFFFFF

// Place segments into the relocation areas
//-Z(CODE_AREA)DATA_ID,START,CODE,DATA_C,INITTAB,DATA_Z,DATA_N=0-FFFFFFFF
//-Z(DATA_AREA)DATA_I=0-FFFFFFFF
// -Felf
