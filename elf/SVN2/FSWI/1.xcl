-carm
//-Z(CODE)CODE=A0FD8000-A0FD80FF
//-Z(CODE)PATCH1=A0092BE4-A0092BE7	//00000134+A0092AB0-00000137+A0092AB0
//-Z(CODE)PATCH2=A0092BA4-A0092BAB	//000000F4+A0092AB0-000000FB+A0092AB0
//-Z(CODE)PATCH3=A0092C54-A0092C57	//000001A4+A0092AB0-000001A7+A0092AB0
//-Z(CODE)LIBR=A0FD4000-A0FD7FFF

-Z(CODE)CODE=A0078000-A00780FF
-Z(CODE)PATCH1=A13A1374-A13A1377	//000002A4+A13A10D0
-Z(CODE)PATCH2=A13A1288-A13A128B	//000001B8+A13A10D0
-Z(CODE)LIBR=A0074000-A0077FFF
