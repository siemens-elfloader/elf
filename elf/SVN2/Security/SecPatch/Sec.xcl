-carm

//-Z(CODE)N3PT=A02FF392-A02FF395
-Z(CODE)N3PT=A02FEC18-A02FEC1B
//A02FEC18
-Z(CODE)PATCH_CODE,PATCH_DATA_C,PATCH_DATA_ID,INITTAB=A006E400-A006EFFF

-Z(CODE)PATCH_DATA_I,PATCH_DATA_N,PATCH_DATA_Z=A80003E0-A80003FF
