-carm
-Z(CODE)START,CODE=A0FD9500-A0FDFFFF
-Z(CONST)INITTAB,DATA_ID,DATA_C=A0FD9500-A0FDFFFF

-Z(CODE)PATCH_ONCREATE=A1734898-A173489B
-Z(CODE)PATCH_ONCLOSE=A173489C-A173489F
-Z(CODE)PATCH_CSMSIZE=A17348A0-A17348A3

-Z(CODE)PATCH_GET_PIT=A0CB75A8-A0CB75BB
