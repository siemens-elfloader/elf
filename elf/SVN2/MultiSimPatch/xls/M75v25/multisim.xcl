-carm
-Z(CODE)PATCH_BODY=0xA00D0000-FFFFFFFF /* основное тело патча */
-Z(CODE)Menu_Hook=0xA04B1A30-FFFFFFFF /* перехват вызова меню */
-Z(CODE)csa1=0xA0A87DE4-FFFFFFFF /* перехват обращения к сим 1 */
-Z(CODE)csa1_1=0xA0A87DF0-FFFFFFFF /* перехват обращения к сим 1 */
-Z(CODE)csa2=0xA0A88194-FFFFFFFF /* перехват обращения к сим 2 */
-Z(CODE)csa2_1=0xA0A881A2-FFFFFFFF /* перехват обращения к сим 2 */
-Z(CODE)Msg_dispatch=0xA0AB1CE8-FFFFFFFF /* перехват ответа */
-Z(CODE)Msg_dispatch_1=0xA0AB1CF4-FFFFFFFF /* перехват ответа */
-Z(CODE)GetLgp=0xA0A84758-FFFFFFFF /* перехват обращения к ленгпаку */
-Z(CODE)SetHTTPProfile=0xA0881E0C-FFFFFFFF /* сохранение HTTP-профиля */
-Z(CODE)SetHTTPProfile_1=0xA0881E18-FFFFFFFF /* сохранение HTTP-профиля */
-Z(CODE)SetSMSProfile=0xA083BF14-FFFFFFFF /* сохранение SMS-профиля */
-Z(CONST)DATA_I,DATA_ID,INITTAB=0xA00D0000-FFFFFFFF
-Z(CONST)DATA_C,DATA_Z=0xA00D0000-FFFFFFFF
-Z(CODE)CODE=0xA00D0000-FFFFFFFF
