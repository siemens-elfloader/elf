-carm
-Z(CODE)PATCH_BODY=0xA00D0000-FFFFFFFF /* основное тело патча */
-Z(CODE)Menu_Hook=0xA092E988-FFFFFFFF /* перехват вызова меню */
-Z(CODE)csa1=0xA1407460-FFFFFFFF /* перехват обращения к сим 1 */
-Z(CODE)csa1_1=0xA140746C-FFFFFFFF /* перехват обращения к сим 1 */
-Z(CODE)csa2=0xA1407810-FFFFFFFF /* перехват обращения к сим 2 */
-Z(CODE)csa2_1=0xA140781E-FFFFFFFF /* перехват обращения к сим 2 */
-Z(CODE)Msg_dispatch=0xA1407E3C-FFFFFFFF /* перехват ответа */
-Z(CODE)Msg_dispatch_1=0xA1407E48-FFFFFFFF /* перехват ответа */
-Z(CODE)SetHTTPProfile=0xA0C79A3C-FFFFFFFF /* сохранение HTTP-профиля */
-Z(CODE)SetHTTPProfile_1=0xA0C79A4C-FFFFFFFF /* сохранение HTTP-профиля */
-Z(CODE)SetSMSProfile=0xA0C4EBE8-FFFFFFFF /* сохранение SMS-профиля */
-Z(CONST)DATA_I,DATA_ID,INITTAB=0xA00D0000-FFFFFFFF
-Z(CONST)DATA_C,DATA_Z=0xA00D0000-FFFFFFFF
-Z(CODE)CODE=0xA00D0000-FFFFFFFF
