-carm
-Z(CODE)PATCH_BODY=0xA00D0000-FFFFFFFF /* основное тело патча */
-Z(CODE)Menu_Hook=0xA04A52E4-FFFFFFFF /* перехват вызова меню */
-Z(CODE)csa1=0xA0A1FF8C-FFFFFFFF /* перехват обращения к сим 1 */
-Z(CODE)csa1_1=0xA0A1FF98-FFFFFFFF /* перехват обращения к сим 1 */
-Z(CODE)csa2=0xA0A2033C-FFFFFFFF /* перехват обращения к сим 2 */
-Z(CODE)csa2_1=0xA0A2034A-FFFFFFFF /* перехват обращения к сим 2 */
-Z(CODE)Msg_dispatch=0xA0A39328-FFFFFFFF /* перехват ответа */
-Z(CODE)Msg_dispatch_1=0xA0A39334-FFFFFFFF /* перехват ответа */
-Z(CODE)GetLgp=0xA0A1CD10-FFFFFFFF /* перехват обращения к ленгпаку */
-Z(CODE)SetHTTPProfile=0x-FFFFFFFF /* сохранение HTTP-профиля */
-Z(CODE)SetHTTPProfile_1=0x-FFFFFFFF /* сохранение HTTP-профиля */
-Z(CONST)DATA_I,DATA_ID,INITTAB=0xA00D0000-FFFFFFFF
-Z(CONST)DATA_C,DATA_Z=0xA00D0000-FFFFFFFF
-Z(CODE)CODE=0xA00D0000-FFFFFFFF
