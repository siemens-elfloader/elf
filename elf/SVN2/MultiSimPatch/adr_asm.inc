#ifdef EL71v45
	#include "xls\el71v45\adr_asm.inc"
#endif
#ifdef E71v45
	#include "xls\e71v45\adr_asm.inc"
#endif
#ifdef S75v47
	#include "xls\S75v47\adr_asm.inc"
#endif


#ifdef S7Cv47
	#include "xls\S7Cv47\adr_asm.inc"
#endif

#ifdef SL75v52
	#include "xls\SL75v52\adr_asm.inc"
#endif

#ifdef C75v22
	#include "xls\C75v22\adr_asm.inc"
#endif
#ifdef CX75v25
	#include "xls\CX75v25\adr_asm.inc"
#endif
#ifdef CX75v13
	#include "xls\CX75v13\adr_asm.inc"
#endif
#ifdef CX70v56
	#include "xls\CX70v56\adr_asm.inc"
#endif
#ifdef M75v25
	#include "xls\M75v25\adr_asm.inc"
#endif

#ifdef S65v58
	#include "xls\S65v58\adr_asm.inc"
#endif

#ifdef SK65v50
	#include "xls\SK65v50\adr_asm.inc"
#endif

#ifdef CF75v22
	#include "xls\CF75v22\adr_asm.inc"
#endif


#ifdef SL65v53
	#include "xls\SL65v53\adr_asm.inc"
#endif
