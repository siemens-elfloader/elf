-carm
-Z(CODE)START,CODE,SWITAB,INITTAB,DATA_ID,DATA_C,CONFIG_DATA_ID=A01B0010-A01B03FF

-Z(CODE)PATCH_ENTRY=A036607C-A036607F 

-Z(CODE)TYPE_ENTRY=A02F1200-A02F1203

-Z(CODE)TYPE_SAVE=A01B0000-A01B000F

-Z(CODE)ADDR_DB_FNAME=A8530400
