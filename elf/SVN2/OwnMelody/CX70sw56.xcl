-carm
-Z(CODE)START,CODE,SWITAB,INITTAB,DATA_ID,DATA_C,CONFIG_DATA_ID=A0803010-A08033FF

-Z(CODE)PATCH_ENTRY=A099BBA4-A099BBA7
-Z(CODE)TYPE_ENTRY=A0963D74-A0963D77
-Z(CODE)TYPE_SAVE=A0803000-A080300F

-Z(CODE)ADDR_DB_FNAME=A86EC320
