-carm
-Z(CODE)CODE,DATA_C=A1359680-FFFFFFFF

-Z(CODE)SMSHook=A0BFE204-FFFFFFFF
//0D220A30????????80BD
-Z(CODE)hookwindow=A05DC61C-FFFFFFFF
//14386844????6944????????061C-8
-Z(CODE)HookShow=A0866E18-FFFFFFFF
//49 4E 53 54 41 4E 54 5F 4D 45 53 53 41 47 45 00??????A0+10