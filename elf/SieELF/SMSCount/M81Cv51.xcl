-carm
-Z(CODE)CODE,DATA_C=A0085800-FFFFFFFF

-Z(CODE)SMSHook=A0B709C4-FFFFFFFF
//0D220A30????????80BD
-Z(CODE)hookwindow=A0304A1C-FFFFFFFF
//14386844????6944????????061C-6
-Z(CODE)HookShow=A045B374-FFFFFFFF
//49 4E 53 54 41 4E 54 5F 4D 45 53 53 41 47 45 00??????A0+10