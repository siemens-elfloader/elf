-carm
-Z(CODE)START,CODE,SWITAB,INITTAB,DATA_ID,DATA_C,CONFIG_DATA_ID=A0078000-A007A000	//ELC1 v41	&	El71 v41

-Z(DATA)CONFIG_DATA_I,DATA_N=A8D9F10C-A8D9FA6B	//A8D9F004-A8D9F963//*(08402DE99BFFFFEB000050E30000E003D800D0110880BDE8+20),95F

-Z(CODE)PATCH_ONCREATE=A08757F0-A08757F3	//A0851A6C-A0851A6F//????????010000004D7269646C6575695F69646C+20
-Z(CODE)PATCH_ONCLOSE=A0875804-A0875807	//A0851A80-A0851A83//????????4401000001000000????????0100000006001D00


-Z(CODE)PATCH_ESI1=A090131C-A090131F	//A08DCC28-A08DCC2B//????????0100A0E3F081BDE8FFBFFF7F7C25647C00000000
-Z(CODE)PATCH_ESI2=A090132C-A090132F	//A08DCC38-A08DCC3B//7C25647C00000000????????70402DE99BDE4DE2

-Z(CODE)PATCH_SHOWMSG_BLF=A081A8A4-A081A8A7	//A07FCCF8-A07FCCFB//7BB797A0,first,8E4AC30700D438320B1C00212BE78A4A
-Z(CODE)PATCH_NO_BROWSE_TXT=A06E6C6A-A06E6C6B	//A06CAD5A-A06CAD5B//0830????????80BD0000????????????????74787400

-Z(CODE)SWILIB_FUNC171=A00745C4-A00745C7
-Z(CODE)SWILIB_FUNC172=A00745C8-A00745CB
-Z(CODE)SWILIB_FUNC19C=A0074670-A0074673
-Z(CODE)SWILIB_FUNC1B8_1BB=A00746E0-A00746EF
-Z(CODE)SWILIB_FUNC1E9=A00747A4-A00747A7

-Z(DATA)REGEXPL_CNT=A8D9F108-A8D9F10B	//A8D9F000-A8D9F003//*(????????08402DE991FFFFEB000050E3000090150880BDE8)

-Z(CODE)PATCH_EXT2_R7=A051DD80-A051DD83	//A0507388-A050738B//BC701FE50060A0E10150A0E10040A0E30F0000EA040184E0
-Z(CODE)PATCH_EXT2_R6=A051DF64-A051DF67	//A050756C-A050756F//A0621FE50050A0E10040A0E3180000EA040184E0
-Z(CODE)PATCH_EXT2_R7_1=A051D9B4-A051D9B7	//A0506FBC-A0506FBF//10739FE510839FE5070000EA056185E0861197E7
-Z(CODE)PATCH_EXT2_R2=A051DB38-A051DB3B	//A0507140-A0507143//8C219FE500C093E5050000EA013181E0

-Z(CODE)PATCH_EXT2_IMPL=A051DE04-A051DE27	//A050740C-A050742F//3C211FE5001092E53C0051E31080BDA8010181E0

-Z(CODE)PATCH_ENABLE_ALTOPEN=A074765C-A074765F	//A0728880-A0728883//0300001A0800A0E1????????000050E30500001AE0039DE5

-Z(CODE)PATCH_GET_PIT=A0979FDA-A0979FDD	//A0953932-A0953935//10B5041C????????A04201D9201C11E0D9
-Z(CODE)PATCH_GET_PITJ=A0979FE0-A0979FE3	//A0953938-A095393B//????A04201D9201C11E0D9494A1C8B1C8C

-Z(CODE)FSWI_PATCH1=A133D0AC-A133D0AF	//A12DA780-A12DA783//2C0000EABC0200000003000010030000	//000002A4+A13A10D0
-Z(CODE)FSWI_PATCH2=A133CFC0-A133CFC3	//A12DA694-A12DA697//63685F41626F7274A100FFFFB0010000	//000001B8+A13A10D0
-Z(CODE)LIBR=A0074000-A0077FFF
