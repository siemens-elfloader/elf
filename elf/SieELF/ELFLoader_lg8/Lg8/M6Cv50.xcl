-carm
-Z(CODE)START,CODE,SWITAB,INITTAB,DATA_ID,DATA_C,CONFIG_DATA_ID=A0FD8000-A0FDA000

-Z(DATA)CONFIG_DATA_I,DATA_N=A8606CC8-A8607444 //*(30402de944d04de2-10),*(D0C10000120200000-8)-4

-Z(CODE)PATCH_ONCREATE=A0A18EA0-A0A18EA3	//76C163736D6B69646CE50000+38
-Z(CODE)PATCH_ONCLOSE=A0A18EA4-A0A18EA7	       //76C163736D6B69646CE50000+3c
-Z(CODE)PATCH_ESI=A12169BC-FFFFFFFF        //0C1C111C??4A904207DB??4A

-Z(CODE)PATCH_NO_UNK_EXT=A08BBC80-FFFFFFFF //04 00 A0 E1 1C D0 8D E2 F0 85 BD E8 30 40 2d e9

-Z(CODE)SWILIB_FUNC00B=A0FD402C-A0FD402F
-Z(CODE)SWILIB_FUNC00C=A0FD4030-A0FD4033
-Z(CODE)SWILIB_FUNC095=A0FD4254-A0FD4257
-Z(CODE)SWILIB_FUNC12B_12D=A0FD44AC-A0FD44B7
-Z(CODE)SWILIB_FUNC171=A0FD45C4-A0FD45C7
-Z(CODE)SWILIB_FUNC172=A0FD45C8-A0FD45CB
-Z(CODE)SWILIB_FUNC19C=A0FD4670-A0FD4673
-Z(CODE)SWILIB_FUNC1B8_1BB=A0FD46E0-A0FD46EF
-Z(CODE)SWILIB_FUNC1E9=A0FD47A4-A0FD47A7

-Z(DATA)REGEXPL_CNT=A8606CC4-A8606CC7
-Z(CODE)REG_FILE=A08BC278-A08BC27F	        //F0452DE920608DE2700096E884A11FE5

-Z(CODE)PATCH_GET_EXT=A08BBC50-A08BBC53        //857288E0141097E50600A0E1
-Z(CODE)PATCH_GET_REGEXT1=A08BBA60-A08BBA63	//81C282E008C09CE504005CE101108112
-Z(CODE)PATCH_GET_REGEXT2=A08BBA74-A08BBA77	//810282E01080BDE8030051E1F6FFFFBA
-Z(CODE)PATCH_BIG_ICON=A09383F0-A09383F3	//010080E2????????0010A0E10600A0E1
-Z(CODE)PATCH_REGEXPL=A08BC360-A08BC363	//C4FFFFEB14D08DE23080BDE810402DE9

-Z(CODE)PATCH_GET_PIT=A00DDC1C-A00DDC1F   //10B5041C????????A04205D9
-Z(CODE)PATCH_GET_PITJ=A00DDC20-A00DDC23	//????????A04205D9????????0069E100401810BD

-Z(CODE)PATCH_KEYB_MSG=A00F2254-A00F2257	//E86A????????00282ED1381CFF38C838
-Z(CODE)PATCH_KEYB_MSGJ=A00F2258-A00F225B	//????00282ED1381CFF38C8382FD1301C

-Z(CODE)FSWI_PATCH1=A0187678-A018767B	//1A0000EA480100005801000068010000
-Z(CODE)FSWI_PATCH2=A018775C-A018775F //0000000000020000FEFFFFEA10402DE9
-Z(CODE)FSWI_PATCH3=A018775B-A018775C
-Z(CODE)LIBR=A0FD4000-A0FD7FFF