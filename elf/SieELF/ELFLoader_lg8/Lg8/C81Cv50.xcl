-carm
// C81Cv50

-Z(CODE)START,CODE,SWITAB,INITTAB,DATA_ID,DATA_C,CONFIG_DATA_ID=A0078000-A007A000

-Z(DATA)CONFIG_DATA_I,DATA_N=A8DF99B0-A8DFA30F  // *(????????FFFF000070B5061C),,*(????????FFFF00001A24201C)-1

-Z(CODE)PATCH_ONCREATE=A04677A0-FFFFFFFF //5F 69 64 6C 65 5F 63 73 ED 00 00 00+10
-Z(CODE)PATCH_ONCLOSE=A04677B4-FFFFFFFF //5F 69 64 6C 65 5F 63 73 ED 00 00 00+24
-Z(CODE)PATCH_ESI1=A096E1B0-FFFFFFFF
-Z(CODE)PATCH_ESI2=A096E1C0-FFFFFFFF //7C 25 64 7C 00 00 00 00
-Z(CODE)PATCH_SHOWMSG_BLF=A06AB744-FFFFFFFF  //...4A C3 07 00 D4 38 32 0B 1C 00 21 30 E7 A0 4A C3
-Z(CODE)PATCH_NO_BROWSE_TXT=A05BBC3E-FFFFFFFF  //74 78 74 00 64 65 76 69-12

-Z(CODE)SWILIB_FUNC171=A00745C4-A00745C7
-Z(CODE)SWILIB_FUNC172=A00745C8-A00745CB
-Z(CODE)SWILIB_FUNC19C=A0074670-A0074673
-Z(CODE)SWILIB_FUNC1B8_1BB=A00746E0-A00746EF
-Z(CODE)SWILIB_FUNC1E9=A00747A4-A00747A7

-Z(CODE)PATCH_EXT2_R4R7=A02A659E-FFFFFFFF     // +
-Z(CODE)PATCH_EXT2_R6R5=A02A66B8-FFFFFFFF     // 2B 4E 05 1C 00 24 37 1F
-Z(CODE)PATCH_EXT2_R5R1=A02A6406-FFFFFFFF     // D8 4D 00 21 2A 1F 12 68
-Z(CODE)PATCH_EXT2_R5R7=A02A6308-FFFFFFFF     // 00 25 28 4F 0A E0 28 26
-Z(CODE)PATCH_EXT2_CLUST1=A02A65CA-FFFFFFFF   // 67 48 04 38 00 68 84 42
-Z(CODE)PATCH_EXT2_CLUST2=A02A6328-FFFFFFFF   // 20 48 04 38 00 68 85 42
-Z(CODE)PATCH_EXT2_JUMPERS=A0511E60-FFFFFFFF  // 28 1C 66 B0 B0 BD 00 00 0A 43 74 78 41 45 5F 50+8
-Z(CODE)PATCH_EXT2_IMPL=A02A65E8-FFFFFFFF    // 5F 4A 04 3A 11 68 3C 29 09 DA 28 20


-Z(CODE)PATCH_ENABLE_ALTOPEN=A036CE96-FFFFFFFF //18d0 05 98 00 28 04 D1 06 98+6

-Z(CODE)PATCH_GET_PIT=A099AE44-FFFFFFFF      // 10 B5 04 1C ????????A0 42 01 D9
-Z(CODE)PATCH_GET_PITJ=A099AE48-FFFFFFFF      // ???????? A0 42 01 D9 20 1C 12 E0 D9 49 4A 1C

-Z(CODE)FSWI_PATCH1=A14FB61C-FFFFFFFF //2C 00 00 EA BC 02 00 00 00 03 00 00 10 03 00 00
-Z(CODE)FSWI_PATCH2=A14FB530-FFFFFFFF //63 68 5F 41 62 6F 72 74 A1 00 FF FF B0 01 00 00
-Z(CODE)LIBR=A0074000-A0077FFF