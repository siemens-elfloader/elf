-carm
-Z(CODE)START,CODE,SWITAB,INITTAB,DATA_ID,DATA_C,CONFIG_DATA_ID=A0FD8000-A0FDA000

-Z(DATA)CONFIG_DATA_I,DATA_N=A8658C18-FFFFFFFF //*(30402de944d04de2-10),*(D0C10000120200000-8)-4

-Z(CODE)PATCH_ONCREATE=A0A56C00-FFFFFFFF	//76C163736D6B69646CE50000+38
-Z(CODE)PATCH_ONCLOSE=A0A56C04-FFFFFFFF       //76C163736D6B69646CE50000+3c
-Z(CODE)PATCH_ESI=A12589D4-FFFFFFFF

-Z(CODE)PATCH_NO_UNK_EXT=A08BC0FC-FFFFFFFF //04 00 A0 E1 1C D0 8D E2 F0 85 BD E8 30 40 2d e9

-Z(CODE)SWILIB_FUNC00B=A0FD402C-A0FD402F
-Z(CODE)SWILIB_FUNC00C=A0FD4030-A0FD4033
-Z(CODE)SWILIB_FUNC095=A0FD4254-A0FD4257
-Z(CODE)SWILIB_FUNC12B_12D=A0FD44AC-A0FD44B7
-Z(CODE)SWILIB_FUNC171=A0FD45C4-A0FD45C7
-Z(CODE)SWILIB_FUNC172=A0FD45C8-A0FD45CB
-Z(CODE)SWILIB_FUNC19C=A0FD4670-A0FD4673
-Z(CODE)SWILIB_FUNC1B8_1BB=A0FD46E0-A0FD46EF
-Z(CODE)SWILIB_FUNC1E9=A0FD47A4-A0FD47A7

-Z(DATA)REGEXPL_CNT=A8658C14-A8658C17
-Z(CODE)REG_FILE=A08BC6F4-A08BC6FB	        //F0452DE920608DE2700096E884A11FE5

-Z(CODE)PATCH_GET_EXT=A08BC0CC-A08BC0CF        //857288E0141097E50600A0E1
-Z(CODE)PATCH_GET_REGEXT1=A08BBEDC-A08BBEDF	//81C282E008C09CE504005CE101108112
-Z(CODE)PATCH_GET_REGEXT2=A08BBEF0-A08BBEF3	//810282E01080BDE8030051E1F6FFFFBA
-Z(CODE)PATCH_BIG_ICON=A094267C-A094267F	//010080E2????????0010A0E10600A0E1
-Z(CODE)PATCH_REGEXPL=A08BC7DC-A08BC7DF	//C4FFFFEB14D08DE23080BDE810402DE9

-Z(CODE)PATCH_GET_PIT=A00DDFC0-A00DDFC3   //10B5041C????????A04205D9
-Z(CODE)PATCH_GET_PITJ=A00DDFC4-A00DDFC7	//????????A04205D9????????0069E100401810BD

-Z(CODE)PATCH_KEYB_MSG=A00F25F8-A00F25FB	//E86A????????00282ED1381CFF38C838
-Z(CODE)PATCH_KEYB_MSGJ=A00F25FC-A00F25FF	//????00282ED1381CFF38C8382FD1301C

-Z(CODE)FSWI_PATCH1=A0187A5C-A0187A5F	//1A0000EA480100005801000068010000
-Z(CODE)FSWI_PATCH2=A0187B40-A0187B43 //0000000000020000FEFFFFEA10402DE9
-Z(CODE)FSWI_PATCH3=A0187B3F-A0187B40
-Z(CODE)LIBR=A0FD4000-A0FD7FFF
