-carm
-Z(CODE)START,CODE,SWITAB,INITTAB,DATA_ID,DATA_C,CONFIG_DATA_ID=A0FD8000-A0FDA000
-Z(DATA)CONFIG_DATA_I,DATA_N=A848C98C-A848D108 //*(30402de944d04de2-10),*(D0C10000120200000-8)-4

-Z(CODE)PATCH_ONCREATE=A0466C54-A0466C57	//76C163736D6B69646CE50000+38
-Z(CODE)PATCH_ONCLOSE=A0466C58-A0466C5B	       //76C163736D6B69646CE50000+3c
-Z(CODE)PATCH_ESI=A07383B4-FFFFFFFF

-Z(CODE)PATCH_NO_UNK_EXT=A029F188-FFFFFFFF //04 00 A0 E1 1C D0 8D E2 F0 85 BD E8 30 40 2d e9

-Z(CODE)SWILIB_FUNC00B=A0FD402C-A0FD402F
-Z(CODE)SWILIB_FUNC00C=A0FD4030-A0FD4033
-Z(CODE)SWILIB_FUNC095=A0FD4254-A0FD4257
-Z(CODE)SWILIB_FUNC12B_12D=A0FD44AC-A0FD44B7
-Z(CODE)SWILIB_FUNC171=A0FD45C4-A0FD45C7
-Z(CODE)SWILIB_FUNC172=A0FD45C8-A0FD45CB
-Z(CODE)SWILIB_FUNC19C=A0FD4670-A0FD4673
-Z(CODE)SWILIB_FUNC1B8_1BB=A0FD46E0-A0FD46EF
-Z(CODE)SWILIB_FUNC1E9=A0FD47A4-A0FD47A7

-Z(DATA)REGEXPL_CNT=A848C988-A848C98B
-Z(CODE)REG_FILE=A029F780-A029F787	        //F0452DE920608DE2700096E884A11FE5

-Z(CODE)PATCH_GET_EXT=A029F158-A029F15B        //B8 A4 9F E5 06 00 00 EA+8
-Z(CODE)PATCH_GET_REGEXT1=A029EF68-A029EF6B	//00 30 93 E5 06 00 00 EA+8
-Z(CODE)PATCH_GET_REGEXT2=A029EF7C-A029EF7F	//
-Z(CODE)PATCH_BIG_ICON=A03412E4-A03412E7	//010080E2????????0010A0E10600A0E1
-Z(CODE)PATCH_REGEXPL=A029F868-A029F86B	//C4FFFFEB14D08DE23080BDE810402DE9

-Z(CODE)PATCH_GET_PIT=A00DF754-A00DF757   //10B5041C????????A04205D9
-Z(CODE)PATCH_GET_PITJ=A00DF758-A00DF75B	//????????A04205D9????????0069E100401810BD

-Z(CODE)PATCH_KEYB_MSG=A00F3D4C-A00F3D4F	//E86A????????00282ED1381CFF38C838
-Z(CODE)PATCH_KEYB_MSGJ=A00F3D50-A00F3D53	//????00282ED1381CFF38C8382FD1301C

-Z(CODE)FSWI_PATCH1=A0188DC4-A0188DC7	//1A0000EA480100005801000068010000
-Z(CODE)FSWI_PATCH2=A0188EA8-A0188EAB	//0000000000020000FEFFFFEA10402DE9
-Z(CODE)FSWI_PATCH3=A0188EA7-A0188EA8	
-Z(CODE)LIBR=A0FD4000-A0FD7FFF