-carm
-Z(CODE)START,CODE,SWITAB,INITTAB,DATA_ID,DATA_C,CONFIG_DATA_ID=A0FC5820-FFFFFFFF

-Z(CODE)PATCH_JUMP=A0FC5800-FFFFFFFF
-Z(CODE)PATCH_ENTRY=A0551F34-FFFFFFFF //1C E0 00 00 08 E0 00 00 B2 02 00 00 20 25 64 00-8
