-carm
-Z(CODE)START,CODE,SWITAB,INITTAB,DATA_ID,DATA_C,CONFIG_DATA_ID=A0065820-FFFFFFFF

-Z(CODE)PATCH_JUMP=A0065800-FFFFFFFF
-Z(CODE)PATCH_ENTRY=A09C23B4-FFFFFFFF //80 69 80 00 0C D4 B8 6A 00 28 09 D1-4
