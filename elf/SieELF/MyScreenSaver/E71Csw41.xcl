-carm
//-Z(CODE)ENTRYPOINT=A05DA8B6-FFFFFFFF
-Z(CODE)ENTRYPOINT_AUTOLOCK=A05DA6F2-FFFFFFFF //KEYLOCK
-Z(CODE)ENTRYPOINT_AUTOLOCK1=A05DA8B2-FFFFFFFF //KEYLOCK
-Z(CODE)ENTRYPOINT_LONGPRESSLOCK=A0707834-FFFFFFFF
//-Z(CODE)ENTRYPOINT_DISABLECSREENSAVER=A05DA8B6-FFFFFFFF
-Z(CODE)HOOK_JMP=A042C478-FFFFFFFF
//-Z(CODE)HOOK_JMP1=A03C7A8C-FFFFFFFF
//-Z(CODE)HOOK_JMP2=A03C7B60-FFFFFFFF
-Z(CODE)CODE_G,CODE,DATA_C,DATA_ID,INITTAB=A135AC00-FFFFFFFF
//-Z(DATA)TIME_ADDR=A135AC00-FFFFFFFF
//-Z(DATA)DATA_Z,DATA_I=A8D80580-FFFFFFFF
-Z(DATA)RAM_TMR,RAMP_XWS,RAM_IsKbdLocked,RAM_CSM_ID,RAM_GUI_ID,MISSED_EVENS=A8D80590-FFFFFFFF

-Z(CODE)KBDLOCK_HOOK=A08F9888-FFFFFFFF
-Z(CODE)DISABLE_SCREENSAVER_HOOK=A06891CA-FFFFFFFF
//-Z(CODE)SCREENSAVER_FIX_HOOK=A05DA6F6-FFFFFFFF
-Z(CODE)SWILIB_IsUnlocked=A007410C-FFFFFFFF
-Z(CODE)SWILIB_KBDLOCK=A00742A4-FFFFFFFF
-Z(CODE)LIGHT_HOOK=A08F1EE2-FFFFFFFF
-Z(CODE)DISABLE_KEYLOCK_MSG_HOOK=A071F7D0-FFFFFFFF
