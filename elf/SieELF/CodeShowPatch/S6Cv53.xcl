-carm

-Z(CODE)JMP_BODY=A0CB1000-FFFFFFFF //S6Cv53地址超出

-Z(CODE)CODE,DATA_C=A080F540-FFFFFFFF  
-Z(CODE)RecordWindow=A0BF071C-FFFFFFFF 
-Z(CODE)Callinwindow=A098FE10-FFFFFFFF 
-Z(CODE)CallOutWindow=A098F1CA-FFFFFFFF 
-Z(CODE)AddrBookWindow=A0BEB094-FFFFFFFF 
-Z(CODE)AddrBookWindow2=A0BEB086-FFFFFFFF 
-Z(CODE)PhonebookWindow=A0C30990-FFFFFFFF 
-Z(CODE)SMS_SEND_HOOK=A1681EB4-FFFFFFFF 

-Z(CODE)SMS_IN_HOOK=0xA092FAC0-FFFFFFFF  //OK
-Z(CODE)CODE_X=A0810000-FFFFFFFF  //OK

-Z(CODE)SMS_SEND_FIX=0xA1681E66-FFFFFFFF  //OK

-Z(CODE)NUM_SELECT_MENU_ALITEM=A0C54354-FFFFFFFF //8298????????0090+2
-Z(CODE)NUM_SELECT_MENU_TEXT=A0C543B8-FFFFFFFF //8298839B0099
-Z(CODE)NUM_SELECT_MENU_GUI=A0C54286-FFFFFFFF  //381C6649+4
-Z(CODE)NUM_SELECT_MENU_HDR_ICON=A0CAE0DC-FFFFFFFF //6162656469747669657773F70000+16h
-Z(CODE)NUM_SELECT_MENU_LINES=A0CAE114-FFFFFFFF //NUM_SELECT_MENU_HDR_ICON+38h

-Z(CODE)SMSHeader_HOOK=A16994D4-FFFFFFFF  //2B1C221C04980399