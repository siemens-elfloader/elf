-carm
-Z(CODE)CODE,CODE_X,DATA_C=A1560000-FFFFFFFF

-Z(CODE)HOOK_DUMP=A042C65C-FFFFFFFF
-Z(CODE)RecordWindow=A05E788C-FFFFFFFF
-Z(CODE)Callinwindow=A02FD304-FFFFFFFF
-Z(CODE)CallOutWindow=A02FCD08-FFFFFFFF
-Z(CODE)AddrBookWindow=A068A938-FFFFFFFF
-Z(CODE)AddrBookWindow2=A068A920-FFFFFFFF
-Z(CODE)PHONEBOOKHOOK=A068F478-FFFFFFFF //04 10 A0 E106 00 A0 E1????????03 30 A0 E300 20 A0 E3+C

-Z(CODE)SMS_IN_HOOK=A0996758-FFFFFFFF

-Z(CODE)NUM_SELECT_MENU_HDR_ICON=A0957D78-FFFFFFFF
-Z(CODE)NUM_SELECT_MENU_LINES=A0957DB0-FFFFFFFF
-Z(CODE)NUM_SELECT_MENU_ALITEM=A068DD14-FFFFFFFF
-Z(CODE)NUM_SELECT_MENU_TEXT=A068DDE8-FFFFFFFF
-Z(CODE)NUM_SELECT_MENU_GUI=A068DB90-FFFFFFFF

-Z(CODE)EDIAL_CREATE_HOOK=A02FB538-FFFFFFFF
-Z(CODE)EDIAL_REDRAW_HOOK=A02FB3B0-FFFFFFFF
-Z(CODE)EDIAL_ATTR_HOOK=A02FB518-FFFFFFFF

-Z(CODE)ADRBKLST_ALLOCWS_HOOK=A068485C-FFFFFFFF
-Z(CODE)ADRBKLST_CATWS_HOOK=A068492C-FFFFFFFF
-Z(CODE)ADRBKLST_ALLOCWS_HOOK2=A068438C-FFFFFFFF
-Z(CODE)ADRBKLST_CATWS_HOOK2=A06843F8-FFFFFFFF
-Z(CODE)ADRBKLST_LINES_HOOK1=A095A0D0-FFFFFFFF
-Z(CODE)ADRBKLST_LINES_HOOK2=A095AC8C-FFFFFFFF
-Z(CODE)ADRBKLST_LINES_HOOK3=A095A100-FFFFFFFF
-Z(CODE)ADRBKLST_SIMALLWS_HOOK=A06A00A8-FFFFFFFF
-Z(CODE)ADRBKLST_SIMNUMWS_HOOK=A06A00FC-FFFFFFFF
-Z(CODE)ADRBKLST_ALLOCWS_HOOK3=A0684BB0-FFFFFFFF
-Z(CODE)ADRBKLST_CATWS_HOOK3=A0684C4C-FFFFFFFF