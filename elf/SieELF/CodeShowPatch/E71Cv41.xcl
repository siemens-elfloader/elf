-carm
-Z(CODE)CODE,DATA_C,CODE_X=A1360000-FFFFFFFF

-Z(CODE)HOOK_DUMP=A0838B10-FFFFFFFF
-Z(CODE)RecordWindow=A09CB818-FFFFFFFF
-Z(CODE)Callinwindow=A067E450-FFFFFFFF
-Z(CODE)CallOutWindow=A067DD94-FFFFFFFF
-Z(CODE)AddrBookWindow3=A0805F96-FFFFFFFF
-Z(CODE)AddrBookWindow=A0805F98-FFFFFFFF
-Z(CODE)PHONEBOOKHOOK=A0BE2748-FFFFFFFF
//-Z(CODE)AddrBookMenu_HOOK1=A0800E3E-FFFFFFFF
//-Z(CODE)AddrBookMenu_HOOK=A0801034-FFFFFFFF
-Z(CODE)NUM_SELECT_MENU_HOOK=A0808294-FFFFFFFF
-Z(CODE)NUM_SELECT_MENU_HOOK1=A08081E4-FFFFFFFF
-Z(CODE)SMS_IN_HOOK=A0965114-FFFFFFFF
//-Z(CODE)CODE_X=A1360780-FFFFFFFF
-Z(CODE)NUM_SELECT_MENU_HDR_ICON=A08D3468-FFFFFFFF
-Z(CODE)NUM_SELECT_MENU_LINES=A08D34A0-FFFFFFFF
-Z(CODE)NUM_SELECT_MENU_ALITEM=A08082D8-FFFFFFFF
-Z(CODE)NUM_SELECT_MENU_TEXT=A0808360-FFFFFFFF
-Z(CODE)NUM_SELECT_MENU_GUI=A08081E0-FFFFFFFF

