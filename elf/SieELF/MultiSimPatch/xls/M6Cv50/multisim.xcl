-carm
-Z(CODE)PATCH_BODY=0xA0803000-FFFFFFFF
-Z(CODE)Menu_Hook=0xA0A34B64-FFFFFFFF
-Z(CODE)csa1=0xA00A0494-FFFFFFFF
//07 9A 08 99 00 20 03 94 ???????? 0B B0 F0 BD
-Z(CODE)csa1_1=0xA00A04A0-FFFFFFFF
//0B B0 F0 BD 02 DF ED 22 D2 01 01 20
-Z(CODE)csa2=0xA00A0844-FFFFFFFF
//01 91 08 99 07 9A 00 20 
-Z(CODE)csa2_1=0xA00A0852-FFFFFFFF
//0B B0 F0 BD 02 DF ED 22 D2 01 02 20 AD 49
-Z(CODE)Msg_dispatch=0xA00D0034-FFFFFFFF
//79 4B 75 4E 59 88 28 3E 01 25 0A 06
-Z(CODE)Msg_dispatch_1=0xA00D0040-FFFFFFFF
//12 0E 04 24 26 2A B1 78 36 D0 09 DC 10 2A 01 D0
-Z(CODE)GetLgp=0xA12169BE-FFFFFFFF
//0C 1C 11 1C???????????????? 90 42 04 D0
-Z(CODE)SetHTTPProfile=0xA101BADC-FFFFFFFF
//00 30 A0 E3 B0 00 C1 E1 00 30 8D E5 04 30 8D E5
-Z(CODE)SetHTTPProfile_1=0xA101BAEC-FFFFFFFF
//04 30 A0 E3 20 05 9F E5 00 20 A0 E3
-Z(CODE)SetSMSProfile=0xA0ABBA00-FFFFFFFF
//80 B5 05 28 04 D8 C8 49 08 70 C8 48
-Z(CONST)DATA_I,DATA_ID,INITTAB=0xA0803000-FFFFFFFF
-Z(CONST)DATA_C,DATA_Z=0xA0803000-FFFFFFFF
-Z(CODE)CODE=0xA0803000-FFFFFFFF