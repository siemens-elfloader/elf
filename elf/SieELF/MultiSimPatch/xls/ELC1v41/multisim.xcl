-carm
-Z(CODE)PATCH_BODY=0xA1AD4000-FFFFFFFF /* основное тело патч?*/
-Z(CODE)Menu_Hook=0xA0865898-FFFFFFFF /* перехват мызова меню */
//pattern_link=44,45,56,49,43,45,5F,4D,41,4E,41,47,45,52,00,00,??,??,??,A?
-Z(CODE)csa1=0xA0D1D7A4-FFFFFFFF /* перехват обращения ?си?1 */
//pattern=??,9A,??,99,??,20,??,94,??,??,??,??,??,B0,??,BD
-Z(CODE)csa2=0xA0D1DB58-FFFFFFFF /* перехват обращения ?си?2 */
//pattern=??,91,??,99,??,9A,??,20,??,94,??,??,??,??,??,B0,??,BD
-Z(CODE)csa1_1=0xA0D1D7B0-FFFFFFFF /* перехват обращения ?си?1 */
//pattern=??,B0,??,BD,??,DF,??,??,??,01,??,22,??,20,??,49
-Z(CODE)csa2_1=0xA0D1DB66-FFFFFFFF /* перехват обращения ?си?2 */
//pattern=??,B0,??,BD,??,DF,??,??,??,01,??,22,??,20,??,49
-Z(CODE)Msg_dispatch=0xA0CFBC3C-FFFFFFFF /* перехват ответа */
//pattern=??,B5,??,49,??,4E,??,68,??,24,??,06,??,0E,??,3E,??,2A,??,D0,??,25,??,2A,??,D0,??,1C,??,78,??,2A,??,D0,??,2A,??,D1,??,29,??,D0,??,29,??,D1
-Z(CODE)Msg_dispatch_1=0xA0CFBC4A-FFFFFFFF /* перехват ответа */
//pattern=??,3E,??,2A,??,D0,??,25,??,2A,??,D0,??,1C,??,78,??,2A,??,D0,??,2A,??,D1,??,29,??,D0,??,29,??,D1,??,20,??,E0
-Z(CONST)DATA_I,DATA_ID,INITTAB=0xA1AD4000-FFFFFFFF
-Z(CONST)DATA_C,DATA_Z=0xA1AD4000-FFFFFFFF
-Z(CODE)CODE=0xA1AD4000-FFFFFFFF
