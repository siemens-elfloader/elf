-carm
-Z(CODE)PATCH_BODY=0xA1AD4000-FFFFFFFF
-Z(CODE)Menu_Hook=0xA0459E74-FFFFFFFF
//44 45 56 49 43 45 5F 4D 41 4E 41 47 45 52 00 00 ??????a0 0000+10
-Z(CODE)csa1=0xA0DEC398-FFFFFFFF
//07 9A 08 99 00 20 03 94 ???????? 0B B0 F0 BD
-Z(CODE)csa2=0xA0DEC74C-FFFFFFFF
//01 91 08 99 07 9A 00 20 ???????? ???? 0B B0
-Z(CODE)csa1_1=0xA0DEC3A4-FFFFFFFF
//0B B0 F0 BD 02 DF ED 23 DB 01 02 22 01 20 CE 49
-Z(CODE)csa2_1=0xA0DEC75A-FFFFFFFF
//0B B0 F0 BD 02 DF ED 23 DB 01 02 22 02 20 CC 49
-Z(CODE)Msg_dispatch=0xA0DD0744-FFFFFFFF
//70 B5 7A 49 75 4E 4A 68 04 24 12 06 12 0E 28 3E
-Z(CODE)Msg_dispatch_1=0xA0DD0752-FFFFFFFF
//28 3E 10 2A 2B D0 01 25 26 2A 33 D0 31 1C C9 78
-Z(CONST)DATA_I,DATA_ID,INITTAB=0xA1AD4000-FFFFFFFF
-Z(CONST)DATA_C,DATA_Z=0xA1AD4000-FFFFFFFF
-Z(CODE)CODE=0xA1AD4000-FFFFFFFF
