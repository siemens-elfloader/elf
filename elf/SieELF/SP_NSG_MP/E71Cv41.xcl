-carm
-Z(CODE)CODE,DATA_C,DATA_I,DATA_ID,INITTAB=A1563C00-FFFFFFFF
//-Z(CODE)Subprovider_PO_HOOK=A03071C4-FFFFFFFF
//-Z(CODE)Provider_WS_HOOK=A0423338-FFFFFFFF
//-Z(CODE)SubProvider_WS_HOOK=A03071DC-FFFFFFFF

-Z(CODE)Subprovider_PO_HOOK=A05D9A8C-FFFFFFFF //0028????01????65????0028
-Z(CODE)Provider_WS_HOOK=A081AEE8-FFFFFFFF
//B0B5051C0C1C????????011C221C 得到函数地址A08EF292
//00C09FE5,1CFF2FE1,93,F2,8E,A0+8 得到Provider_WS_HOOK
-Z(CODE)SubProvider_WS_HOOK=A05D9AA4-FFFFFFFF //301C????????EA79