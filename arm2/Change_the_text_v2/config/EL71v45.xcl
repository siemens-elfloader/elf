-carm
-Z(CODE)PATCH_BODY,START,CODE,SWITAB,INITTAB,DATA_ID,DATA_C,CONFIG_DATA_ID=A1310080-FFFFFFFF
-Z(DATA)CODE_I,DATA_Z,DATA_N,DATA_I,CONFIG_DATA_I=A8F00500-A8F00600

-Z(CODE)FIX_COMMAND=A071D4D0-FFFFFFFF
-Z(CODE)VREZKA=A071D4D4-FFFFFFFF